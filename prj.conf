## CMakeLists.txt
```
cmake_minimum_required(VERSION 3.20.0)

find_package(Zephyr REQUIRED HINTS $ENV{ZEPHYR_BASE})
project(indoor_air)

target_sources(app PRIVATE src/main.c)
```

## Kconfig
```
mainmenu "Golioth application options"

if DNS_RESOLVER

config DNS_SERVER_IP_ADDRESSES
    default y

config DNS_SERVER1
    default "1.1.1.1"

endif # DNS_RESOLVER

source "Kconfig.zephyr"
```

## west.yml
```
manifest:
  projects:
    - name: golioth
      path: modules/lib/golioth
      revision: v0.5.0
      url: https://github.com/golioth/golioth-zephyr-sdk
      west-commands: scripts/west-commands.yml
      import:
        file: west-zephyr.yml
        path-prefix: deps
        name-allowlist:
          - zephyr
          - hal_espressif
          - mbedtls
          - mcuboot
          - net-tools
          - qcbor
          - tinycrypt
  self:
    path: app
    west-commands: utility/west-commands/west-commands.yml
```

## prj.conf
```kconfig
CONFIG_GOLIOTH_SAMPLES_COMMON=y

# Generic networking options
CONFIG_NETWORKING=y
CONFIG_NET_IPV4=y
CONFIG_NET_IPV6=n

# Logging
CONFIG_NET_LOG=y

# Network Shell
CONFIG_NET_SHELL=n

# TLS configuration
CONFIG_MBEDTLS_ENABLE_HEAP=y
CONFIG_MBEDTLS_HEAP_SIZE=10240
CONFIG_MBEDTLS_SSL_MAX_CONTENT_LEN=2048

# Application
CONFIG_MAIN_STACK_SIZE=4096

CONFIG_GOLIOTH=y
CONFIG_GOLIOTH_SYSTEM_CLIENT=y

CONFIG_MINIMAL_LIBC_MALLOC_ARENA_SIZE=256

CONFIG_LOG_BACKEND_GOLIOTH=y
CONFIG_LOG_PROCESS_THREAD_STACK_SIZE=2048

CONFIG_GPIO=y
CONFIG_I2C=y

CONFIG_SHELL=y
CONFIG_I2C_SHELL=y

CONFIG_SENSOR_SHELL=y
CONFIG_SENSOR=y
```

## boards/esp32s2_saola.conf
```kconfig
CONFIG_ESP_SPIRAM=y

CONFIG_WIFI=y
CONFIG_HEAP_MEM_POOL_SIZE=37760
CONFIG_ESP32_WIFI_NET_ALLOC_SPIRAM=y

CONFIG_NET_L2_ETHERNET=y

CONFIG_NET_DHCPV4=y

CONFIG_MBEDTLS_ENTROPY_ENABLED=y
CONFIG_MBEDTLS_KEY_EXCHANGE_ECDHE_ECDSA_ENABLED=y
CONFIG_MBEDTLS_ECP_ALL_ENABLED=y

CONFIG_ESP32_WIFI_STA_AUTO_DHCPV4=y

CONFIG_NET_L2_WIFI_SHELL=y
CONFIG_GOLIOTH_SAMPLE_WIFI=y

CONFIG_ESP32_WIFI_STATIC_RX_BUFFER_NUM=8
CONFIG_ESP32_WIFI_DYNAMIC_RX_BUFFER_NUM=8
CONFIG_ESP32_WIFI_DYNAMIC_TX_BUFFER_NUM=8
CONFIG_ESP32_WIFI_IRAM_OPT=n
CONFIG_ESP32_WIFI_RX_IRAM_OPT=n
```

## src/main.c
```c
#include <zephyr/logging/log.h>
LOG_MODULE_REGISTER(golioth_hello, LOG_LEVEL_DBG);

#include <net/golioth/system_client.h>
#include <samples/common/net_connect.h>
#include <zephyr/net/coap.h>

static struct golioth_client *client = GOLIOTH_SYSTEM_CLIENT_GET();

static K_SEM_DEFINE(connected, 0, 1);

static void golioth_on_connect(struct golioth_client *client)
{
  k_sem_give(&connected);
}

void main(void)
{
  int counter = 0;
  int err;

  LOG_DBG("Start Hello sample");

  if (IS_ENABLED(CONFIG_GOLIOTH_SAMPLES_COMMON))
  {
    net_connect();
  }

  client->on_connect = golioth_on_connect;
  golioth_system_client_start();

  k_sem_take(&connected, K_FOREVER);

  while (true)
  {
    LOG_INF("Sending hello! %d", counter);

    err = golioth_send_hello(client);
    if (err)
    {
      LOG_WRN("Failed to send hello!");
    }
    ++counter;
    k_sleep(K_SECONDS(5));
  }
}
```
